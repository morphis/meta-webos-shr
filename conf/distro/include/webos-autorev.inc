## conf/distro/include/webos-autorev.inc
```bitbake
SRCREV_pn-powerd = "${AUTOREV}"
SRCREV_pn-sleepd = "${AUTOREV}"
SRCREV_pn-nyx-lib = "${AUTOREV}"
SRCREV_pn-nyx-common-linux-modules = "${AUTOREV}"
SRCREV_pn-cjson-openwebos = "${AUTOREV}"
SRCREV_pn-luna-service2 = "${AUTOREV}"
SRCREV_pn-storaged = "${AUTOREV}"
SRCREV_pn-nodejs-openwebos = "${AUTOREV}"
SRCREV_pn-pmloglib = "${AUTOREV}"
SRCREV_pn-luna-sysmgr-ipc = "${AUTOREV}"
SRCREV_pn-luna-webkit-api = "${AUTOREV}"
SRCREV_pn-luna-sysmgr-ipc-messages = "${AUTOREV}"
SRCREV_pn-npapi-headers = "${AUTOREV}"
SRCREV_pn-pbnjson = "${AUTOREV}"
SRCREV_pn-enyo = "${AUTOREV}"
```

## conf/layer.conf
```bitbake
# We have a conf and classes directory, append to BBPATH
BBPATH .= ":${LAYERDIR}"

# We have a recipes directory, add to BBFILES
BBFILES += "${LAYERDIR}/recipes*/*/*.bb ${LAYERDIR}/recipes*/*/*.bbappend"

BBFILE_COLLECTIONS += "webos-layer"
BBFILE_PATTERN_webos-layer := "^${LAYERDIR}/"
BBFILE_PRIORITY_webos-layer = "8"
```
